## src/Kconfig.isotp_fast
```kconfig
menuconfig ISOTP_FAST
    bool "New ISO-TP context"
    depends on CAN
    depends on ISOTP
    select EVENTS

if ISOTP_FAST

config ISOTP_FAST_RX_MAX_PACKET_COUNT
  int "Max packets for ISO-TP reception"
  default 8
  help
    Max number of packets expected in a single ISO-TP message.

config ISOTP_FAST_PER_FRAME_DISPATCH
  bool "Per-frame dispatch"
  default false
  help
    Whether to invoke the receive callback on receipt of every frame

endif
```

## twister-out.1/native_posix_64/can/thingset_sdk.can/Kconfig/Kconfig.modules
```kconfig
menu "ThingSet SDK (/home/gaz/thingset-zephyr-sdk/thingset-zephyr-sdk.git)"
osource "/home/gaz/thingset-zephyr-sdk/thingset-zephyr-sdk.git/Kconfig"
config ZEPHYR_THINGSET_SDK_MODULE
	bool
	default y
endmenu
menu "thingset-node-c (/home/gaz/thingset-zephyr-sdk/modules/thingset-node-c)"
osource "/home/gaz/thingset-zephyr-sdk/modules/thingset-node-c/Kconfig.thingset"
config ZEPHYR_THINGSET_NODE_C_MODULE
	bool
	default y
endmenu
menu "hal_espressif (/home/gaz/thingset-zephyr-sdk/modules/hal/espressif)"
osource "/home/gaz/thingset-zephyr-sdk/modules/hal/espressif/zephyr/Kconfig"
config ZEPHYR_HAL_ESPRESSIF_MODULE
	bool
	default y
endmenu
menu "hal_nordic (/home/gaz/thingset-zephyr-sdk/modules/hal/nordic)"
osource "$(ZEPHYR_HAL_NORDIC_KCONFIG)"
config ZEPHYR_HAL_NORDIC_MODULE
	bool
	default y
endmenu
menu "loramac-node (/home/gaz/thingset-zephyr-sdk/modules/lib/loramac-node)"
osource "$(ZEPHYR_LORAMAC_NODE_KCONFIG)"
config ZEPHYR_LORAMAC_NODE_MODULE
	bool
	default y
endmenu
menu "mbedtls (/home/gaz/thingset-zephyr-sdk/modules/crypto/mbedtls)"
osource "$(ZEPHYR_MBEDTLS_KCONFIG)"
config ZEPHYR_MBEDTLS_MODULE
	bool
	default y
endmenu
menu "picolibc (/home/gaz/thingset-zephyr-sdk/modules/lib/picolibc)"
osource "/home/gaz/thingset-zephyr-sdk/modules/lib/picolibc/zephyr/Kconfig"
config ZEPHYR_PICOLIBC_MODULE
	bool
	default y
endmenu
menu "zcbor (/home/gaz/thingset-zephyr-sdk/modules/lib/zcbor)"
osource "$(ZEPHYR_ZCBOR_KCONFIG)"
config ZEPHYR_ZCBOR_MODULE
	bool
	default y
endmenu
```

## west.yml
```yaml
# Copyright (c) The ThingSet Project Contributors
# SPDX-License-Identifier: Apache-2.0

manifest:
  remotes:
    - name: zephyrproject
      url-base: https://github.com/zephyrproject-rtos
    - name: thingset
      url-base: https://github.com/ThingSet
    - name: garethpotter
      url-base: https://github.com/garethpotter
    - name: libresolar
      url-base: https://github.com/LibreSolar
  projects:
    - name: zephyr
      remote: zephyrproject
      revision: v3.5-branch
      import:
        name-allowlist:
          - cmsis
          - edtt
          - hal_espressif
          - hal_nordic
          - hal_stm32
          - hal_st
          - loramac-node
          - mbedtls
          - tinycrypt
          - picolibc
    - name: thingset-node-c
      remote: garethpotter
      revision: cd64eb9890ce2ff8abad78b9e60b618b520ffd06
      path: modules/thingset-node-c
      import: true
```
